#ifdef HAS_MOUSE_TP
  #include <dt-bindings/zmk/mouse.h>
  #include <dt-bindings/zmk/mouse_settings.h>
  #include <behaviors/mouse_keys.dtsi>
  #include <behaviors/mouse_setting.dtsi>

 /*
  * Keymap settings for the trackpoint.
  *
  * These are referenced from config/corne_tp.keymap to provide
  * runtime adjustment of trackpoint parameters.
  *
  * NOTE: In ZMK main, the input-processor-scaler replaces the old
  * mouse_ps2 sensitivity config. Use &tp_scaler settings instead.
  */


  // Key codes to adjust trackpoint sensitivity at runtime.
  // Note: these work with the external infused-kim PS/2 module.
  // If the module doesn't support these, they'll be no-ops.

  #define U_MSS_TP_S_I &mms MS_TP_SENSITIVITY_INCR
  #define U_MSS_TP_S_D &mms MS_TP_SENSITIVITY_DECR

  #define U_MSS_TP_V6_I &mms MS_TP_VALUE6_INCR
  #define U_MSS_TP_V6_D &mms MS_TP_VALUE6_DECR

  #define U_MSS_TP_NI_I &mms MS_TP_NEG_INERTIA_INCR
  #define U_MSS_TP_NI_D &mms MS_TP_NEG_INERTIA_DECR

  #define U_MSS_TP_PT_I &mms MS_TP_PTS_THRESHOLD_INCR
  #define U_MSS_TP_PT_D &mms MS_TP_PTS_THRESHOLD_DECR

  #define U_MSS_RESET   &mms MS_RESET
  #define U_MSS_LOG     &mms MS_LOG


  // Apply settings only on the side that has the TP connected (the right side).
  #ifdef MOUSE_PS2_DT_PRESENT

   /*
    * Mouse Driver Settings
    *
    * These are applied to the `mouse_ps2` node and are mostly
    * related to the trackpoint hardware configuration.
    * For axis transforms and sensitivity scaling, use the
    * input-processors defined in corne_tp_right.overlay.
    */

    &mouse_ps2 {

      // How sensitive the TP is (Default: 128)
      // tp-sensitivity = <128>;

      // The maximum mouse movement speed the TP will accelerate to (Default: 97)
      // tp-val6-upper-speed = <97>;

      // Negative Inertia (Default: 6)
      // tp-neg-inertia = <6>;

      // Enable clicking by tapping on the TP (not all TPs support this)
      // tp-press-to-select;
      // tp-press-to-select-threshold = <10>;

      // Adjust axis settings on the TP (works on some trackpoints)
      // tp-xy-swap;
      // tp-x-invert;
      // tp-y-invert;

      // Sampling rate in hz. Default: 100. Lower values save battery.
      // Allowed: 10, 20, 40, 60, 80, 100, 200
      // sampling-rate = <60>;

      // Disable clicking to prevent accidental clicks with error-prone GPIO driver
      // disable-clicking;

      // Enable scroll wheel for mouse devices supporting Intellimouse extension
      // scroll-mode;
    };

  #endif  // MOUSE_PS2_DT_PRESENT

#endif  // HAS_MOUSE_TP
