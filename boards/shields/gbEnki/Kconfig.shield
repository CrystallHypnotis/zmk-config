## boards/shields/gbEnki/Kconfig.shield
```kconfig
# Copyright (c) 2020 The ZMK Contributors
# SPDX-License-Identifier: MIT

config SHIELD_GBENKI_LEFT
	def_bool $(shields_list_contains,gbEnki_left)

config SHIELD_GBENKI_RIGHT
	def_bool $(shields_list_contains,gbEnki_right)

config SHIELD_GBENKI_DONGLE
	def_bool $(shields_list_contains,gbEnki_dongle)
```
